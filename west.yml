## west.yml
```yaml
manifest:
  group-filter: [+zview-gui]
  remotes:
    - name: zano-systems
      url-base: https://github.com/zano-systems
  projects:
    - name: zview-gui
      remote: zano-systems
      revision: v0.5.2
      path: modules/tools/zview-gui
      groups: [zview-gui]
      west-commands: scripts/west-commands.yml
```
